## manifest/west.yml
```yaml
west:
  url: https://github.com/zephyrproject-rtos/west
  revision: v0.6.0

manifest:
  remotes:
    - name: ncs
      url-base: https://github.com/nrfconnect
    - name: board_nrf9160
      url-base: git@gitlab.osmos-dev.com:systemesembarques/ltem_project
    - name: board_nrf52832
      url-base: git@gitlab.osmos-dev.com:systemesembarques/ltem_project
  projects:
    - name: nrf
      remote: ncs
      revision: v1.8.0
      repo-path: sdk-nrf
      import:
        path-prefix: external/sdk
  self:
    path: manifest-repo
```
